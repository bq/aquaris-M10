/*************************
 * Customized Battery Setting dtsi file
*************************/
&bat_comm {
	/* cust_charging.h */
	/* stop charging while in talking mode */
	stop_charging_in_takling = <1>;
	talking_recharge_voltage = <3800>;
	talking_sync_time = <60>;

	/* Battery Temperature Protection */
	mtk_temperature_recharge_support = <1>;
	max_charge_temperature = <45>;
	max_charge_temperature_minus_x_degree = <41>;
	min_charge_temperature = <(-5)>;
	min_charge_temperature_plus_x_degree = <6>;
	err_charge_temperature = <0xff>;

	/* Linear Charging Threshold */
	v_pre2cc_thres = <3400>;	/* unit: mV */
	v_cc2topoff_thres = <4050>;
	recharging_voltage = <4110>;
	charging_full_current = <150>;	/* unit: mA */

	/* Charging Current Setting */
	config_usb_if = <0>;
	usb_charger_current_suspend = <0>;	/* Unit: 0.01 mA */
	usb_charger_current_unconfigured = <7000>;	/* Unit: 0.01 mA */
	usb_charger_current_configured = <50000>;	/* Unit: 0.01 mA */

	usb_charger_current = <50000>;	/* Unit: 0.01 mA */
	ac_charger_current = <205600>;	/* Unit: 0.01 mA */

	non_std_ac_charger_current = <50000>;	/* Unit: 0.01 mA */
	non_std_ac_charger_charger_current = <110000>; /* Unit: 0.01 mA */

	charging_host_charger_current = <65000>;	/* Unit: 0.01 mA */
	apple_0_5a_charger_current = <50000>;	/* Unit: 0.01 mA */
	apple_1_0a_charger_current = <65000>;	/* Unit: 0.01 mA */
	apple_2_1a_charger_current = <80000>;	/* Unit: 0.01 mA */

	/* charger error check */
	bat_low_temp_protect_enable = <1>;
	v_charger_enable = <0>;	/* 1:on , 0:off */
	v_charger_max = <6000>;	/* unit: mV */
	v_charger_min = <4400>;

	/*  Tracking TIME */
	onehundred_percent_tracking_time = <10>;	/* Unit: second */
	npercent_tracking_time = <20>;	/* Unit: second */
	sync_to_real_tracking_time = <60>;	/* Unit: second */
	v_0percent_tracking = <3450>;	/* Unit: mV */
	system_off_voltage = <3450>;	/* Unit: mV */

	/* High battery support */
	high_battery_voltage_support = <1>;
};

&bat_meter {
	/* cust_battery_meter.h */
	/* ADC resistor  */
	r_bat_sense = <4>;
	r_i_sense = <4>;
	r_charger_1 = <330>;
	r_charger_2 = <39>;
	temperature_t0 = <110>;
	temperature_t1 = <0>;
	temperature_t2 = <25>;
	temperature_t3 = <50>;
	temperature_t = <255>;	/* this should be fixed, never change the value */
	fg_meter_resistance = <0>;

	/* Qmax for 0mA */
	q_max_pos_50 = <7149>;
	q_max_pos_25 = <7149>;
	q_max_pos_0 = <7149>;
	q_max_neg_10 = <7149>;
	/* Qmax for 600mA, said high current */
	q_max_pos_50_h_current = <7075>;
	q_max_pos_25_h_current = <7075>;
	q_max_pos_0_h_current = <7075>;
	q_max_neg_10_h_current = <7075>;
	/* Discharge percentage, 1: D5, 0: D2 */
	oam_d5 = <0>;

	change_tracking_point = <1>;
	/* SW OCV tracking setting */
	cust_tracking_point = <14>;
	cust_r_sense = <200>;
	cust_hw_cc = <0>;
	aging_tuning_value = <100>;
	cust_r_fg_offset = <0>;
	ocv_board_compesate = <0>;
	r_fg_board_base = <1000>;
	r_fg_board_slope = <1000>;
	car_tune_value = <89>;
	system_off_voltage = <3450>;	/* Unit: mV */

	/* HW Fuel gague  */
	current_detect_r_fg = <(-1)>;	/* Unit: mA */
	minerroroffset = <1000>;
	fg_vbat_average_size = <18>;
	r_fg_value = <0>;	/* Unit: mOhm */

	cust_poweron_delta_capacity_tolrance = <80>;
	cust_poweron_low_capacity_tolrance = <5>;
	cust_poweron_max_vbat_tolrance = <70>;
	cust_poweron_delta_vbat_tolrance = <60>;
	cust_poweron_delta_hw_sw_ocv_capacity_tolrance = <10>;

	/* Fixed battery temperature */
	fixed_tbat_25 = <0>;
	/* Dynamic change wake up period of battery thread when suspend */
	vbat_normal_wakeup = <3600>;	/* Unit: mV */
	vbat_low_power_wakeup = <3500>;	/* Unit: mV */
	normal_wakeup_period = <5400>;	/* Unit: second */
	low_power_wakeup_period = <300>;	/* Unit: second */
	close_poweroff_wakeup_period = <30>;	/* Unit: second */

	rbat_pull_up_r = <16900>;
	rbat_pull_up_volt = <1800>;

	batt_temperature_table_num = <17>;
	batt_temperature_table = <
			    (-20) 75022
			    (-15) 57926
			    (-10) 45168
			    (-5) 35548
			    0 28224
			    5 22595
			    10 18231
			    15 14820
			    20 12133
			    25 10000 30 8295 35 6922 40 5810 45 4903 50 4160 55 3547 60 3039>;

	battery_profile_t0_num = <54>;
	battery_profile_t0 = <0 4310
				2 4267
				/*3 4248*/
				4 4232
				/*5 4226*/
				7 4211
				8 4204
				10 4195
				/*11 4184*/
				12 4169
				14 4154
				/*15 4149*/
				16 4145
				18 4120
				/*19 4115*/
				20 4101
				22 4098
				/*23 4082*/
				24 4072
				26 4062
				27 4046
				29 4037
				/*30 4014*/
				31 4005
				33 3989
				/*34 3973*/
				35 3964
				37 3953
				/*38 3941*/
				39 3937
				41 3922
				42 3918
				44 3906
				/*45 3898*/
				46 3890
				48 3879
				/*49 3872*/
				50 3865
				52 3859
				/*53 3853*/
				54 3848
				56 3843
				/*57 3838*/
				58 3830
				60 3819
				61 3815
				63 3813
				/*64 3810*/
				65 3809
				67 3804
				/*68 3803*/
				69 3800
				71 3789
				/*72 3788*/
				73 3784
				75 3779
				76 3775
				78 3770
				/*79 3766*/
				80 3752
				82 3747
				/*83 3740*/
				84 3733
				86 3727
				/*87 3719*/
				88 3708
				90 3704
				/*91 3692*/
				92 3690
				94 3688
				95 3679
				97 3652
				/*98 3605*/
				99 3553
				100 3500>;

	battery_profile_t1_num = <54>;
	battery_profile_t1 = <0 4310
				2 4267
				/*3 4248*/
				4 4232
				/*5 4226*/
				7 4211
				8 4204
				10 4195
				/*11 4184*/
				12 4169
				14 4154
				/*15 4149*/
				16 4145
				18 4120
				/*19 4115*/
				20 4101
				22 4098
				/*23 4082*/
				24 4072
				26 4062
				27 4046
				29 4037
				/*30 4014*/
				31 4005
				33 3989
				/*34 3973*/
				35 3964
				37 3953
				/*38 3941*/
				39 3937
				41 3922
				42 3918
				44 3906
				/*45 3898*/
				46 3890
				48 3879
				/*49 3872*/
				50 3865
				52 3859
				/*53 3853*/
				54 3848
				56 3843
				/*57 3838*/
				58 3830
				60 3819
				61 3815
				63 3813
				/*64 3810*/
				65 3809
				67 3804
				/*68 3803*/
				69 3800
				71 3789
				/*72 3788*/
				73 3784
				75 3779
				76 3775
				78 3770
				/*79 3766*/
				80 3752
				82 3747
				/*83 3740*/
				84 3733
				86 3727
				/*87 3719*/
				88 3708
				90 3704
				/*91 3692*/
				92 3690
				94 3688
				95 3679
				97 3652
				/*98 3605*/
				99 3553
				100 3500>;

	battery_profile_t2_num = <54>;
	battery_profile_t2 = <0 4310
				2 4267
				/*3 4248*/
				4 4232
				/*5 4226*/
				7 4211
				8 4204
				10 4195
				/*11 4184*/
				12 4169
				14 4154
				/*15 4149*/
				16 4145
				18 4120
				/*19 4115*/
				20 4101
				22 4098
				/*23 4082*/
				24 4072
				26 4062
				27 4046
				29 4037
				/*30 4014*/
				31 4005
				33 3989
				/*34 3973*/
				35 3964
				37 3953
				/*38 3941*/
				39 3937
				41 3922
				42 3918
				44 3906
				/*45 3898*/
				46 3890
				48 3879
				/*49 3872*/
				50 3865
				52 3859
				/*53 3853*/
				54 3848
				56 3843
				/*57 3838*/
				58 3830
				60 3819
				61 3815
				63 3813
				/*64 3810*/
				65 3809
				67 3804
				/*68 3803*/
				69 3800
				71 3789
				/*72 3788*/
				73 3784
				75 3779
				76 3775
				78 3770
				/*79 3766*/
				80 3752
				82 3747
				/*83 3740*/
				84 3733
				86 3727
				/*87 3719*/
				88 3708
				90 3704
				/*91 3692*/
				92 3690
				94 3688
				95 3679
				97 3652
				/*98 3605*/
				99 3553
				100 3500>;

	battery_profile_t3_num = <54>;
	battery_profile_t3 = <0 4310
				2 4267
				/*3 4248*/
				4 4232
				/*5 4226*/
				7 4211
				8 4204
				10 4195
				/*11 4184*/
				12 4169
				14 4154
				/*15 4149*/
				16 4145
				18 4120
				/*19 4115*/
				20 4101
				22 4098
				/*23 4082*/
				24 4072
				26 4062
				27 4046
				29 4037
				/*30 4014*/
				31 4005
				33 3989
				/*34 3973*/
				35 3964
				37 3953
				/*38 3941*/
				39 3937
				41 3922
				42 3918
				44 3906
				/*45 3898*/
				46 3890
				48 3879
				/*49 3872*/
				50 3865
				52 3859
				/*53 3853*/
				54 3848
				56 3843
				/*57 3838*/
				58 3830
				60 3819
				61 3815
				63 3813
				/*64 3810*/
				65 3809
				67 3804
				/*68 3803*/
				69 3800
				71 3789
				/*72 3788*/
				73 3784
				75 3779
				76 3775
				78 3770
				/*79 3766*/
				80 3752
				82 3747
				/*83 3740*/
				84 3733
				86 3727
				/*87 3719*/
				88 3708
				90 3704
				/*91 3692*/
				92 3690
				94 3688
				95 3679
				97 3652
				/*98 3605*/
				99 3553
				100 3500>;

	r_profile_t0_num = <54>;
	r_profile_t0 = <147 4310
				147 4267
				/*147 4248*/
				148 4232
				/*148 4226*/
				152 4211
				150 4204
				150 4195
				/*152 4184*/
				152 4169
				152 4154
				/*152 4149*/
				152 4145
				155 4120
				/*157 4115*/
				157 4101
				160 4098
				/*167 4082*/
				167 4072
				162 4062
				160 4046
				162 4037
				/*163 4014*/
				167 4005
				172 3989
				/*173 3973*/
				173 3964
				172 3953
				/*170 3941*/
				167 3937
				160 3922
				155 3918
				152 3906
				/*148 3895*/
				148 3890
				148 3879
				/*148 3872*/
				148 3865
				148 3859
				/*148 3853*/
				150 3848
				150 3843
				/*150 3838*/
				152 3830
				152 3819
				152 3815
				152 3813
				/*155 3810*/
				153 3809
				155 3804
				/*155 3803*/
				155 3800
				155 3789
				/*155 3788*/
				152 3784
				152 3779
				152 3775
				150 3770
				/*150 3766*/
				150 3752
				152 3747
				/*152 3740*/
				152 3733
				153 3727
				/*153 3719*/
				152 3708
				152 3704
				/*153 3692*/
				157 3690
				160 3688
				163 3679
				160 3652
				/*163 3605*/
				183 3553
				200 3500>;

	r_profile_t1_num = <54>;
	r_profile_t1 = <147 4310
				147 4267
				/*147 4248*/
				148 4232
				/*148 4226*/
				152 4211
				150 4204
				150 4195
				/*152 4184*/
				152 4169
				152 4154
				/*152 4149*/
				152 4145
				155 4120
				/*157 4115*/
				157 4101
				160 4098
				/*167 4082*/
				167 4072
				162 4062
				160 4046
				162 4037
				/*163 4014*/
				167 4005
				172 3989
				/*173 3973*/
				173 3964
				172 3953
				/*170 3941*/
				167 3937
				160 3922
				155 3918
				152 3906
				/*148 3895*/
				148 3890
				148 3879
				/*148 3872*/
				148 3865
				148 3859
				/*148 3853*/
				150 3848
				150 3843
				/*150 3838*/
				152 3830
				152 3819
				152 3815
				152 3813
				/*155 3810*/
				153 3809
				155 3804
				/*155 3803*/
				155 3800
				155 3789
				/*155 3788*/
				152 3784
				152 3779
				152 3775
				150 3770
				/*150 3766*/
				150 3752
				152 3747
				/*152 3740*/
				152 3733
				153 3727
				/*153 3719*/
				152 3708
				152 3704
				/*153 3692*/
				157 3690
				160 3688
				163 3679
				160 3652
				/*163 3605*/
				183 3553
				200 3500>;

	r_profile_t2_num = <54>;
	r_profile_t2 = <147 4310
				147 4267
				/*147 4248*/
				148 4232
				/*148 4226*/
				152 4211
				150 4204
				150 4195
				/*152 4184*/
				152 4169
				152 4154
				/*152 4149*/
				152 4145
				155 4120
				/*157 4115*/
				157 4101
				160 4098
				/*167 4082*/
				167 4072
				162 4062
				160 4046
				162 4037
				/*163 4014*/
				167 4005
				172 3989
				/*173 3973*/
				173 3964
				172 3953
				/*170 3941*/
				167 3937
				160 3922
				155 3918
				152 3906
				/*148 3895*/
				148 3890
				148 3879
				/*148 3872*/
				148 3865
				148 3859
				/*148 3853*/
				150 3848
				150 3843
				/*150 3838*/
				152 3830
				152 3819
				152 3815
				152 3813
				/*155 3810*/
				153 3809
				155 3804
				/*155 3803*/
				155 3800
				155 3789
				/*155 3788*/
				152 3784
				152 3779
				152 3775
				150 3770
				/*150 3766*/
				150 3752
				152 3747
				/*152 3740*/
				152 3733
				153 3727
				/*153 3719*/
				152 3708
				152 3704
				/*153 3692*/
				157 3690
				160 3688
				163 3679
				160 3652
				/*163 3605*/
				183 3553
				200 3500>;

	r_profile_t3_num = <54>;
	r_profile_t3 = <147 4310
				147 4267
				/*147 4248*/
				148 4232
				/*148 4226*/
				152 4211
				150 4204
				150 4195
				/*152 4184*/
				152 4169
				152 4154
				/*152 4149*/
				152 4145
				155 4120
				/*157 4115*/
				157 4101
				160 4098
				/*167 4082*/
				167 4072
				162 4062
				160 4046
				162 4037
				/*163 4014*/
				167 4005
				172 3989
				/*173 3973*/
				173 3964
				172 3953
				/*170 3941*/
				167 3937
				160 3922
				155 3918
				152 3906
				/*148 3895*/
				148 3890
				148 3879
				/*148 3872*/
				148 3865
				148 3859
				/*148 3853*/
				150 3848
				150 3843
				/*150 3838*/
				152 3830
				152 3819
				152 3815
				152 3813
				/*155 3810*/
				153 3809
				155 3804
				/*155 3803*/
				155 3800
				155 3789
				/*155 3788*/
				152 3784
				152 3779
				152 3775
				150 3770
				/*150 3766*/
				150 3752
				152 3747
				/*152 3740*/
				152 3733
				153 3727
				/*153 3719*/
				152 3708
				152 3704
				/*153 3692*/
				157 3690
				160 3688
				163 3679
				160 3652
				/*163 3605*/
				183 3553
				200 3500>;
};
