## kernel/drivers/misc/mediatek/heart_rate_sensor/Kconfig
```kconfig
config CUSTOM_KERNEL_HEART_RATE_SENSOR
	bool "CUSTOM_KERNEL_HEART_RATE_SENSOR"
	help
	  Kernel space heart rate sensor driver.

config CUSTOM_KERNEL_HEART
	bool "CUSTOM_KERNEL_HEART"
	help
	  Kernel space heart rate sensor driver.
```

## kernel/drivers/misc/mediatek/magnetometer/Kconfig
```kconfig
config MTK_AUTO_DETECT_MAGNETOMETER
	bool "MTK_AUTO_DETECT_MAGNETOMETER"
	help
	  one load to support different magnetometer sensor

config CUSTOM_KERNEL_MAGNETOMETER
	bool "CUSTOM_KERNEL_MAGNETOMETER"
	help
	  compass driver to detect compass raw data and report orientatino
	  data

source "drivers/misc/mediatek/magnetometer/af7133/Kconfig"
source "drivers/misc/mediatek/magnetometer/akm8963/Kconfig"
source "drivers/misc/mediatek/magnetometer/akm8963-new/Kconfig"
source "drivers/misc/mediatek/magnetometer/akm8975/Kconfig"
source "drivers/misc/mediatek/magnetometer/akm8975_auto/Kconfig"
source "drivers/misc/mediatek/magnetometer/akm09911/Kconfig"
source "drivers/misc/mediatek/magnetometer/akm09911-new/Kconfig"
source "drivers/misc/mediatek/magnetometer/ami304/Kconfig"
source "drivers/misc/mediatek/magnetometer/ami304_auto/Kconfig"
source "drivers/misc/mediatek/magnetometer/bmm050/Kconfig"
source "drivers/misc/mediatek/magnetometer/bmm050-new/Kconfig"
source "drivers/misc/mediatek/magnetometer/bmm056/Kconfig"
source "drivers/misc/mediatek/magnetometer/bmm056-new/Kconfig"
source "drivers/misc/mediatek/magnetometer/bmm150/Kconfig"
source "drivers/misc/mediatek/magnetometer/hscdtd006/Kconfig"
source "drivers/misc/mediatek/magnetometer/hscdtd006_auto/Kconfig"
source "drivers/misc/mediatek/magnetometer/ist8303-new/Kconfig"
source "drivers/misc/mediatek/magnetometer/lsm303c-new/Kconfig"
source "drivers/misc/mediatek/magnetometer/lsm303m/Kconfig"
source "drivers/misc/mediatek/magnetometer/mag3110/Kconfig"
source "drivers/misc/mediatek/magnetometer/mc41xx/Kconfig"
source "drivers/misc/mediatek/magnetometer/mc64xx/Kconfig"
source "drivers/misc/mediatek/magnetometer/mc6420/Kconfig"
source "drivers/misc/mediatek/magnetometer/mmc328x/Kconfig"
source "drivers/misc/mediatek/magnetometer/mmc328x_auto/Kconfig"
source "drivers/misc/mediatek/magnetometer/mmc328xma/Kconfig"
source "drivers/misc/mediatek/magnetometer/mmc3416x/Kconfig"
source "drivers/misc/mediatek/magnetometer/qmc5983/Kconfig"
source "drivers/misc/mediatek/magnetometer/s62x/Kconfig"
source "drivers/misc/mediatek/magnetometer/st480/Kconfig"
source "drivers/misc/mediatek/magnetometer/yamaha529/Kconfig"
source "drivers/misc/mediatek/magnetometer/yamaha530/Kconfig"
source "drivers/misc/mediatek/magnetometer/yamaha532/Kconfig"
source "drivers/misc/mediatek/magnetometer/yamaha532-new/Kconfig"
source "drivers/misc/mediatek/magnetometer/yamaha537/Kconfig"
source "drivers/misc/mediatek/magnetometer/bmc056_mag/Kconfig"
```

## kernel/drivers/misc/mediatek/step_counter/Kconfig
```kconfig
config CUSTOM_KERNEL_STEP_COUNTER
	bool "CUSTOM_KERNEL_STEP_COUNTER"
	help
	  Kernel space step counter driver.

config CUSTOM_KERNEL_SIGNIFICANT_MOTION_SENSOR
	bool "CUSTOM_KERNEL_SIGNIFICANT_MOTION_SENSOR"
	help
	  Kernel space sigificant motion sensor driver.
```

## kernel/drivers/misc/mediatek/vibrator/Kconfig
```kconfig
config MTK_VIBRATOR
	tristate "MediaTek Vibrator driver"
        default y
	---help---
	  Vibrator driver support for MediaTek SOC
	  If you want to use MediaTek Vibrator driver, say Y or M here.
	  If unsure, say N.
```

## kernel/sound/soc/mediatek/Kconfig
```kconfig
config MT_SND_SOC_V1
	bool "MT_SND_SOC_V1"
    default n
    help
        If you say Y, enable MT_SND_SOC_V1_driver.
config MT_SND_SOC_V2
    bool "MT_SND_SOC_V2"
	default n
	help
        If you say Y, enable MT_SND_SOC_V2_driver.
config MT_SND_SOC_V3
    bool "MT_SND_SOC_V3"
	default n
	help
        If you say Y, enable MT_SND_SOC_V3_driver.				
config MT_SND_SOC_6580
    bool "MT_SND_SOC_6580"
	default n
	help
        If you say Y, enable MT_SND_SOC_6580_driver.
config MT_SND_SOC_8163
    bool "MT_SND_SOC_8163"
	default n
	help
        If you say Y, enable MT_SND_SOC_8163_driver.
config MTK_SPEAKER
	bool "MTK_SPEAKER"
	default n
	help
	  If you say Y, enable MTK_SPEAKER_AMP
config MTK_NXP_TFA9890
    bool "MTK_NXP_TFA9890"
	default n
	help
        If you say Y, enable MTK_NXP_TFA9890 driver.
config MT_SND_SOC_8163
    bool "MT_SND_SOC_8163"
       default n
       help
        If you say Y, enable MT_SND_SOC_8163_driver.
config AW8738_SPEAKER_AMP
    bool "AW8738_SPEAKER_AMP"
       default n
       help
        If you say Y, enable MT_SND_SOC_8163_driver.
config EXT_HP_AMP
    bool "Extenal hp amp"
       default n
       help
        If you say Y, enable EXT_HP_AMP.
config TPA6130A_HP_AMP
    bool "TPA6130A HP AMP"
       depends on EXT_HP_AMP
       default n
       help
        If you say Y, enable TPA6130A_HP_AMP.
```
