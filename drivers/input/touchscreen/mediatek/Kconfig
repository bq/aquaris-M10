## drivers/input/touchscreen/mediatek/Kconfig
```kconfig
#
# Touchscreen driver configuration
#
menuconfig INPUT_TOUCHSCREEN
	bool "Touchscreens"
	help
	  Say Y here, and a list of supported touchscreens will be displayed.
	  This option doesn't affect the kernel.

	  If unsure, say Y.

if INPUT_TOUCHSCREEN

config TOUCHSCREEN_MTK
	bool "MediaTek Touch Panel Driver"
	help
	  Say Y here if you have MediaTek touch panel.

	  If unsure, say N.

	  To compile this dirver as a module, choose M here: the
	  module will be called.

config TOUCHSCREEN_MTK_GT1151
	bool "GT1151 for Mediatek package"
	default n
	help
	  Say Y here if you have GT1151 touch panel.

	  If unsure, say N.

	  To compile this dirver as a module, choose M here: the
	  module will be called.

source "drivers/input/touchscreen/mediatek/GT1151/Kconfig"

config TOUCHSCREEN_MTK_GT1151TB
	bool "GT1151 for Mediatek package"
	default n
	help
	  Say Y here if you have GT1151 touch panel.

	  If unsure, say N.

	  To compile this dirver as a module, choose M here: the
	  module will be called.

source "drivers/input/touchscreen/mediatek/GT1151TB/Kconfig"

config TOUCHSCREEN_MTK_GT928
	tristate "GT928 Touchscreen"
	help
	  Say Y here if you have Goodix GT928 touchscreen,
	  connected to your system.
	  If unsure, say N.
	  To compile this driver as a module, choose M here.

config TOUCHSCREEN_MTK_GT9XXTB_HOTKNOT
	bool "GT9XXTB hotknot for Mediatek package"
	default n
	help
	  Say Y here if you have GT9xx touch panel.

	  If unsure, say N.

	  To compile this dirver as a module, choose M here: the
	  module will be called.

source "drivers/input/touchscreen/mediatek/GT9XXTB_hotknot/Kconfig"

config TOUCHSCREEN_MTK_SYNAPTICS_I2C_RMI4
	tristate "Synaptics DSX I2C touchscreen"
	depends on I2C
	help
	  Say Y here if you have a Synaptics DSX I2C touchscreen
	  connected to your system.

	  If unsure, say N.

	  To compile this driver as a module, choose M here: the
	  module will be called synaptics_i2c_rmi4.

source "drivers/input/touchscreen/mediatek/synaptics_i2c_rmi4/Kconfig"

config TOUCHSCREEN_MTK_GT910
	bool "GT910 for Mediatek package"
	default n
	help
	  Say Y here if you have GT910 touch panel.

	  If unsure, say N.

	  To compile this dirver as a module, choose M here: the
	  module will be called.

source "drivers/input/touchscreen/mediatek/GT910/Kconfig"

config TOUCHSCREEN_MTK_FT5X0X_NEW
       bool "FT5X0X NEW for Mediatek package"
       default n
       help
         Say Y here if you have FT5X0X NEW touch panel.

         If unsure, say N.

         To compile this dirver as a module, choose M here: the
         module will be called.

source "drivers/input/touchscreen/mediatek/ft5x0x_new/Kconfig"

config TOUCHSCREEN_MTK_FT6X36
       bool "FT6X36 for Mediatek package"
       default n
       help
         Say Y here if you have FT6X36 touch panel.

         If unsure, say N.

         To compile this dirver as a module, choose M here: the
         module will be called.

source "drivers/input/touchscreen/mediatek/ft6x36/Kconfig"

endif
```

## drivers/input/touchscreen/mediatek/ft5x0x_new/Kconfig
```kconfig
#
# Touchscreen driver configuration
#
if TOUCHSCREEN_MTK_FT5X0X_NEW

config FT5X0X_FIRMWARE
	string "FT5X0X for Mediatek firmware"

config TPD_ROTATE_90
	bool "ft5x0x for Mediatek package"
	default n
	help
	Say Y here if you have ft5x0x touch panel TPD_ROTATE_90.

	If unsure, say N.

	To compile this dirver as a module, choose M here: the
	module will be called.

config TPD_ROTATE_180
	bool "ft5x0x for Mediatek package"
	default n
	help
	Say Y here if you have ft5x0x touch panel TPD_ROTATE_180.

	If unsure, say N.

	To compile this dirver as a module, choose M here: the
	module will be called.

config TPD_ROTATE_270
	bool "ft5x0x for Mediatek package"
	default n
	help
	Say Y here if you have ft5x0x touch panel TPD_ROTATE_270.

	If unsure, say N.

	To compile this dirver as a module, choose M here: the
	module will be called.

config FT_AUTO_UPGRADE_SUPPORT
	bool "ft5x0x for Mediatek package"
	default y
	help
	Say Y here if you have ft5x0x touch panel FT_AUTO_UPGRADE_SUPPORT.

	If unsure, say N.

	To compile this dirver as a module, choose M here: the
	module will be called.

config CUST_FTS_APK_DEBUG
	bool "ft5x0x for Mediatek package"
	default y
	help
	Say Y here if you have ft5x0x touch panel CUST_FTS_APK_DEBUG.

	If unsure, say N.

	To compile this dirver as a module, choose M here: the
	module will be called.

config TPD_HAVE_CALIBRATION
	bool "ft5x0x for Mediatek package"
	default n
	help
	Say Y here if you have ft5x0x touch panel TPD_HAVE_CALIBRATION.

	If unsure, say N.

	To compile this dirver as a module, choose M here: the
	module will be called.

config TPD_CUSTOM_CALIBRATION
	bool "ft5x0x for Mediatek package"
	default n
	help
	Say Y here if you have ft5x0x touch panel TPD_CUSTOM_CALIBRATION.

	If unsure, say N.

	To compile this dirver as a module, choose M here: the
	module will be called.
	
config TPD_DOUBLE_CLICK_WAKEUP
	bool "support double click wakeup the system"
	default n
	help
	Say Y here if you have ft5x0x touch panel TPD_DOUBLE_CLICK_WAKEUP.

	If unsure, say N.

	To compile this dirver as a module, choose M here: the
	module will be called.

config SWITCH_FT5826_HIDI2C_TO_STDI2C
	bool "support switch FT5826 HIDI2C mode to STDI2C mode"
	default n
	help
	Say Y here support switch FT5826 HIDI2C mode to STDI2C mode.

	If unsure, say N.

	To compile this dirver as a module, choose M here: the
	module will be called.

config NONE_FT5826_AUTO_UPGRADE
	bool "disbale ft5826 auto upgrate"
	default n
	help
	Say Y here disbale ft5826 auto upgrate.

	If unsure, say N.

	To compile this dirver as a module, choose M here: the
	module will be called.

config FT5X0X_POWER_HIGH_VOLTAGE
	bool "enable CTP power high voltage"
	default n
	help
	Say Y here enable CTP power high voltage.

	If unsure, say N.

	To compile this dirver as a module, choose M here: the
	module will be called.

config FT5X0X_COMPATIBLE_FT5826S
	bool "enable CTP FT5X0X compatible with FT5826S"
	default n
	help
	Say Y here enable CTP FT5X0X compatible with FT5826S.

	If unsure, say N.

	To compile this dirver as a module, choose M here: the
	module will be called.

endif
```

## drivers/input/touchscreen/mediatek/ft6x36/Kconfig
```kconfig
#
# Touchscreen driver configuration
#
if TOUCHSCREEN_MTK_FT6X36


config TPD_CUSTOM_FT6X36
	bool "ft5x0x for Mediatek package"
	default n
	help
	Say Y here if you have ft5x0x touch panel TPD_CUSTOM_CALIBRATION.

	If unsure, say N.

	To compile this dirver as a module, choose M here: the
	module will be called.
endif
```

## drivers/input/touchscreen/mediatek/gtx5_new/Kconfig
```kconfig
#
# Goodix touchscreen driver configuration
#
menuconfig TOUCHSCREEN_GOODIX_GTX5_NEW
	bool "Goodix GTx5 touchscreen"
	depends on I2C
	default n
	help
	  Say Y here if you have a Goodix GTx5xx touchscreen connected
	  to your system.

	  If unsure, say N.

if TOUCHSCREEN_GOODIX_GTX5_NEW

config TOUCHSCREEN_GOODIX_GTX5_UPDATE_NEW
	tristate "Goodix GTx5 firmware update module"
	default n
	help
	  Say Y here to enable support for doing firmware update.

	  If unsure, say N.

	  To compile this driver as a module, choose M here.

config TOUCHSCREEN_GOODIX_GTX5_TOOLS_NEW
	tristate "Goodix touch tools support"
	default n
	help
	  Say Y here to enable debug tools.

	  If unsure, say N.

	  To compile this driver as a module, choose M here.

endif
```

## drivers/misc/mediatek/accelerometer/KXTJ2_1009-new/Kconfig
```kconfig
config MTK_KXTJ2_1009_NEW
        bool "KXTJ2_1009_NEW for MediaTek package"
        default n
        help
           KXTJ2_1009_NEW
```

## drivers/misc/mediatek/accelerometer/bma255-new/Kconfig
```kconfig
config MTK_BMA255
        bool "BMA255 for MediaTek package"
        default n
	help
	  It support different accelerometer sensor.
          If this option is set,
	  it will support
          BMA255 Accelerometer.
```

## drivers/misc/mediatek/alsps/ltr303/Kconfig
```kconfig
config MTK_LTR303
	bool "MTK_LTR303 for MediaTek package"
	default n
	help
	It support different type sensor
	in this platform. If this option
	is set, it will support ambient
	and light sensor MTK_LTR303.

config LTRKARIN
        bool "Calibration factor for LTR sensor in Karin"
        default n
```

## drivers/misc/mediatek/gyroscope/bmg160-new/Kconfig
```kconfig
config MTK_BMG160
	bool "BMG160 for MediaTek package"
	default n
        help
        It support different gyroscope sensor.
        If this option is set,
	  	it will support
         BMG160 gyroscope.
```

## drivers/misc/mediatek/magnetometer/bmm150-new/Kconfig
```kconfig
config MTK_BMM150
	bool "MTK_BMM150 for MediaTek package"
	default n
	help
	  It support different magnetometer sensor.
          If this option is set,
	  it will support
          MTK_BMM150 magnetometer.
```

## drivers/misc/mediatek/sensors-1.0/alsps/ltr303/Kconfig
```kconfig
config MTK_LTR303
	bool "MTK_LTR303 for MediaTek package"
	default n
	help
	It support different type sensor
	in this platform. If this option
	is set, it will support ambient
	and light sensor MTK_LTR303.
```

## drivers/misc/mediatek/sensors-1.0/temperature_humidity/Kconfig
```kconfig
config CUSTOM_KERNEL_TEM_HUM
	bool "CUSTOM KERNEL TEM & HUM Config"
	help
		temperature & humidity support

source "drivers/misc/mediatek/sensors-1.0/temperature_humidity/si7006/Kconfig"
```

## drivers/misc/mediatek/sensors-1.0/temperature_humidity/si7006/Kconfig
```kconfig
#
# temperature sensor drivers configuration
#

config MTK_SI7006
  bool "temperature&humidity sensor si7006"
  default n
```

## drivers/voice/Kconfig
```kconfig
#
# Voice configuration
#

config VOICE
	bool "VOICE MODULE SUPPORT"
	default n
    help
        If you say Y, enable voice module support.

source "drivers/voice/iflytek/Kconfig"
```

## drivers/voice/iflytek/Kconfig
```kconfig
config IFLYTEK
	bool "iflytek module support"
	default n

source "drivers/voice/iflytek/xfm10211/Kconfig"
source "drivers/voice/iflytek/xfm10213/Kconfig"
source "drivers/voice/iflytek/xfm10412/Kconfig"
```

## kernel/drivers/misc/mediatek/accdet/Kconfig
```kconfig
config MTK_ACCDET
	tristate "MediaTek ACCDET driver"
	---help---
	  ACCDET driver support for MediaTek SOC
	  If you want to use MediaTek ACCDET driver, say Y or M here.
	  If unsure, say N.
```

## kernel/drivers/misc/mediatek/accelerometer/Kconfig
```kconfig
config MTK_AUTO_DETECT_ACCELEROMETER
	bool "MTK_AUTO_DETECT_ACCELEROMETER"
	depends on MTK_SENSOR_SUPPORT
	help
	  one load to support different accelerometer sensor
	  
config CUSTOM_KERNEL_ACCELEROMETER
	bool "CUSTOM_KERNEL_ACCELEROMETER"
	help
	  accelerometer sensor to detect accelerometer from x y z axis.

source "drivers/misc/mediatek/accelerometer/bma2xx/Kconfig"
source "drivers/misc/mediatek/accelerometer/bma050/Kconfig"
source "drivers/misc/mediatek/accelerometer/bma050-new/Kconfig"
source "drivers/misc/mediatek/accelerometer/bma056/Kconfig"
source "drivers/misc/mediatek/accelerometer/bma222E/Kconfig"
source "drivers/misc/mediatek/accelerometer/bma222E-new/Kconfig"
source "drivers/misc/mediatek/accelerometer/bma250/Kconfig"
source "drivers/misc/mediatek/accelerometer/bma250e/Kconfig"
source "drivers/misc/mediatek/accelerometer/bma255-sdo0/Kconfig"
source "drivers/misc/mediatek/accelerometer/bma255-sdo1/Kconfig"
source "drivers/misc/mediatek/accelerometer/k2dh/Kconfig"
source "drivers/misc/mediatek/accelerometer/kxtik1004/Kconfig"
source "drivers/misc/mediatek/accelerometer/KXTJ2_1009/Kconfig"
source "drivers/misc/mediatek/accelerometer/KXTJ2_1009-new/Kconfig"
source "drivers/misc/mediatek/accelerometer/lsm6ds3/Kconfig"
source "drivers/misc/mediatek/accelerometer/mc3xxx_auto/Kconfig"
source "drivers/misc/mediatek/accelerometer/mc3410-new/Kconfig"
source "drivers/misc/mediatek/accelerometer/mpu60x0/Kconfig"
source "drivers/misc/mediatek/accelerometer/mpu6050g/Kconfig"
source "drivers/misc/mediatek/accelerometer/mpu6050g-new/Kconfig"
source "drivers/misc/mediatek/accelerometer/mpu6515/Kconfig"
source "drivers/misc/mediatek/accelerometer/mxc400x-new/Kconfig"
source "drivers/misc/mediatek/accelerometer/bmc056_acc/Kconfig"
```

## kernel/drivers/misc/mediatek/alsps/Kconfig
```kconfig
config CUSTOM_KERNEL_ALSPS
	bool "CUSTOM_KERNEL_ALSPS"
	help
	  ALSPS sensor driverto detect ambint light and the object is close
	  or far awary from device

config MTK_AUTO_DETECT_ALSPS
	bool "MTK_AUTO_DETECT_ALSPS"
	help
	  This feature Option is used for projects which using more than one
	  ALSPS sensors, more than one ALSPS drivers can be builded in to
	  project and be auto detected by setting this option to yes

source "drivers/misc/mediatek/alsps/APDS9930/Kconfig"
source "drivers/misc/mediatek/alsps/APDS9930-new/Kconfig"
source "drivers/misc/mediatek/alsps/apm_16d/Kconfig"
source "drivers/misc/mediatek/alsps/cm3232-new/Kconfig"
source "drivers/misc/mediatek/alsps/cm36283/Kconfig"
source "drivers/misc/mediatek/alsps/cm36283-new/Kconfig"
source "drivers/misc/mediatek/alsps/cm36652-new/Kconfig"
source "drivers/misc/mediatek/alsps/epl2182/Kconfig"
source "drivers/misc/mediatek/alsps/EPL2182-new/Kconfig"
source "drivers/misc/mediatek/alsps/rpr410/Kconfig"
source "drivers/misc/mediatek/alsps/stk3x1x/Kconfig"
source "drivers/misc/mediatek/alsps/stk3x1x-new/Kconfig"
source "drivers/misc/mediatek/alsps/tmd2771/Kconfig"
source "drivers/misc/mediatek/alsps/tmd2771_auto/Kconfig"
source "drivers/misc/mediatek/alsps/ltr303/Kconfig"
```

## kernel/drivers/misc/mediatek/emd_ctl/Kconfig
```kconfig
config MTK_EXTMD_CTRL
	tristate "external MD control"
	default n
	help
	  Config external md control module.


config CUSTOM_KERNEL_EXTMD
	string "external MD customization"
	depends on MTK_EXTMD_CTRL
	default ""
	help
	  Config external md type. Possible choice can be "mt6261" or "mt6261_x2".
```

## kernel/drivers/misc/mediatek/emi_mpu/Kconfig
```kconfig
config MTK_EMI_MPU
  bool CONFIG_MTK_EMI_MPU
  default y
  help
    CONFIG_MTK_EMI_MPU


config MTK_EMI_REG_RW
  bool CONFIG_MTK_EMI_REG_RW
  default n
  help
    CONFIG_MTK_EMI_REG_RW
```
